## CMakeLists.txt
```
# SPDX-License-Identifier: Apache-2.0

cmake_minimum_required(VERSION 3.20.0)
find_package(Zephyr REQUIRED HINTS $ENV{ZEPHYR_BASE})
project(final_test)

target_sources(app PRIVATE src/main.c)
```

## prj.conf
```kconfig
CONFIG_GPIO=y
CONFIG_SPI=y
CONFIG_STDOUT_CONSOLE=y
CONFIG_I2C=y
CONFIG_SENSOR=y

# Logger module
CONFIG_LOG=y

# Bluetooth LE
CONFIG_BT=y
CONFIG_BT_PERIPHERAL=y
CONFIG_BT_DEVICE_NAME="Nordic_LBS"

# LBS service
CONFIG_DK_LIBRARY=y

# Security Management Protocol
CONFIG_BT_SMP=y

CONFIG_SETTINGS=y
CONFIG_BT_SETTINGS=y
CONFIG_FLASH=y
CONFIG_FLASH_PAGE_LAYOUT=y
CONFIG_FLASH_MAP=y
CONFIG_NVS=y

# If filter list:
CONFIG_BT_FILTER_ACCEPT_LIST=y
CONFIG_BT_PRIVACY=y
```

## src/main.c
```c
/* #include <zephyr/kernel.h>
#include <zephyr/drivers/gpio.h>
#include <nrf_soc.h>
#include <nrf_gpio.h>
#include <nrf_delay.h>
#include <nrf_nvic.h>
#include <ble.h>
#include <ble_gap.h>
#include <sensor_driver.h> */


#include <stdio.h>
#include <stdlib.h>
#include <unistd.h>
#include <stdbool.h>
#include <stdint.h>
#include <nrf.h>
#include "nrf_delay.h"
#include "nrf_drv_twi.h"
#include "nrf_ble_qwr.h"
#include "nrf_sdh.h"
#include "nrf_sdh_ble.h"
#include "nrf_sdh_soc.h"
#include "bluetooth.h"
#include "HR_Strss_01.h"

#include "MAX30210.h"
#include "MAX30001.h"
#include "ICP20100.h"
#include "LSM6DSV16X.h"
#include "MAX86140.h"
#include "PWM_Motor.h"
#include "LED_RGB.h"

#include "sensors.h" // Include your sensor header file
#include "stress_detection_algorithm.h" // Include your stress detection algorithm header file

#include <zephyr/settings/settings.h>

#define DEVICE_NAME "StressWristband" 
#define APP_BLE_OBSERVER_PRIO 3       // BLE observer priority

static nrf_drv_twi_t m_twi = NRF_DRV_TWI_INSTANCE(0); // TWI instance
static nrf_drv_spi_t m_spi = NRF_DRV_SPI_INSTANCE(0); // SPI instance for MAX30001

// Initialize SPI (MAX30001 & MAX86140 sensor communication)
static void spi_init(void) {
    ret_code_t err_code;

    nrf_drv_spi_config_t spi_config = NRF_DRV_SPI_DEFAULT_CONFIG;
    spi_config.ss_pin = SPI_SS_PIN;
    spi_config.miso_pin = SPI_MISO_PIN;
    spi_config.mosi_pin = SPI_MOSI_PIN;
    spi_config.sck_pin = SPI_SCK_PIN;
    spi_config.frequency = NRF_DRV_SPI_FREQ_1M;
    spi_config.mode = NRF_DRV_SPI_MODE_0;

    err_code = nrf_drv_spi_init(&m_spi, &spi_config, NULL, NULL);
    APP_ERROR_CHECK(err_code);
}

// Initialize TWI (I2C) for sensor communication
static void twi_init(void) {
    ret_code_t err_code;

    const nrf_drv_twi_config_t twi_config = {
        .scl                = SCL_PIN,
        .sda                = SDA_PIN,
        .frequency          = NRF_TWI_FREQ_100K,
        .interrupt_priority = APP_IRQ_PRIORITY_HIGH,
        .clear_bus_init     = false
    };

    err_code = nrf_drv_twi_init(&m_twi, &twi_config, NULL, NULL);
    APP_ERROR_CHECK(err_code);

    nrf_drv_twi_enable(&m_twi);
}

// Initialize BLE stack
static void ble_stack_init(void) {
    ret_code_t err_code;

    err_code = nrf_sdh_enable_request();
    APP_ERROR_CHECK(err_code);

    err_code = nrf_sdh_ble_default_cfg_set(APP_BLE_OBSERVER_PRIO);
    APP_ERROR_CHECK(err_code);

    err_code = nrf_sdh_ble_enable(&m_erase_bonds);
    APP_ERROR_CHECK(err_code);
}

// Main application loop
int main(void) {
    // Initialize microcontroller
    // ...

    // Initialize peripherals
    // ...

    // Initialize BLE stack
    ble_stack_init();

    // Initialize TWI (I2C)
    twi_init();

    // Initialize SPI for MAX30001 sensor
    spi_init();

    // Initialize sensors
    initMAX86140(); // Initialization function for MAX86140 sensor (example)
    initMAX30001();
    
    // Define buffers
    int sample1[] = {158233, 157389, 156587, 156082, 155676, 155377, 155204, 155121, 155027, 155010,
        155045, 155232, 155480, 155740, 155923, 156111, 156350, 156629, 156938, 157262,
        157655, 158051, 158540, 158915, 158754, 158233, 157839, 157704, 157601, 157495,
        157569, 157578, 157631, 157701, 157865, 158064, 158264, 158511, 158744, 159075,
        159303, 159508, 159941, 160288, 160321, 159943, 159355, 158965, 158773, 158718,
        158710, 158607, 158540, 158370, 158349, 158396, 158434, 158550, 158618, 158766,
        158880, 159042, 159242, 159354, 159392, 159003, 158569, 158328, 158184, 158119,
        158180, 158266, 158280, 158325, 158418, 158574, 158732, 158888, 159129, 159321,
        159515, 159757, 160081, 160378, 160561, 160643, 160308, 159857, 159557, 159434,
        159245, 159283, 159328, 159305, 159355, 159425, 159516, 159702, 159893, 160111,
        160327, 160526, 160802};
        
    int MAX30210values[1];
    int MAX86140values[2];
    int MAX30001values[3];
    int ICP20100values[2];
    int LSM6DSV16Xvalues[6];
    int val = 0;

    while (true) {
    	
        // Acquire sensor data
        readMAX86140Data(MAX86140values); //Reading data from MAX86140 sensor's FIFO (example)
        readMAX30001Data(MAX30001values);
        readMAX30210Data(MAX30210values);
        readICP20100Data(ICP20100values);
        readLSM6DSV16XData(LSM6DSV16Xvalues);
        Motor(val); // Descomentar para pruebas
        LED3(val);  // Descomentar para pruebas

        // Run stress detection algorithm
        // runStressDetectionAlgorithm(); //Function to run the stress detection algorithm (example)
        int valhr = HR(sample1, sizeof(sample1) / sizeof(sample1[0]));
    	//printf("%d\n", valhr);
    	int val = runStressDetectionAlgorithm(5, valhr);
    	Motor(val); 
        LED3(val);
    	
    	return 0;

        // Implement power management strategies
        // ...
        
        // Send data over Bluetooth
        // ...

        // Sleep or other idle tasks
        // ...
        
    }
}
```

## src/HR_Strss_01.h
```c
#include <stdio.h>
#include <stdlib.h>
#include <unistd.h> 

int HR(int data[], int size) {
    int peaks[2] = {0};
    int hrl[7] = {0};
    int HRs[1] = {4};
    int ctr = 0;   // peaks counter
    int strt = 0;  
    int ctr2 = 0;  // last HR guaranteed

    while (1) {
        //sleep(1);
        
        //printf("%d\n", strt);
        //val = real data
        //hrl[ctr] = val; # for de moment:
        hrl[ctr] = data[strt];
        strt++;
        ctr++;
        while (strt > 5) {
            ctr++;
            //sleep(1);
            int i;
            //printf("%d\n", ctr);          

            if (hrl[3] > hrl[2] && hrl[3] > hrl[4] && hrl[3] > hrl[0] && hrl[3] > hrl[6]) {
                //printf("Ok\n");
                peaks[1] = ctr;
                int dpp = peaks[1] - peaks[0];
                switch (dpp) {
                    case 0 ... 17:
                        HRs[0] = 1;
                        break;
                    case 18 ... 23:
                        HRs[0] = 2;
                        break;
                    default:
                        HRs[0] = 0;
                        break;
                }
                ctr2++;
                peaks[0]=ctr;
            }

            for (i = 0; i < 6; i++) {
                hrl[i] = hrl[i + 1];
            }
            hrl[6] = data[strt];
            strt++;
            
            if (ctr2 > 1) {
                return HRs[0];
            }
        }
    }
}

int runStressDetectionAlgorithm(int gap, int hr) {
    int lt[5] = {0};
    int ct = 0;
    int i;
    int fval[1] = {0};

    while (1) {
        sleep(1);
        int lt0[6] = {0};

        for (i = 0; i < 6; i++) {
            lt0[i] = rand() % 11;
        }

        int val = lt0[0];
        for (i = 1; i < 6; i++) {
            if (lt0[i] > val) {
                val = lt0[i];
            }
        }

        lt[4] = val;

        switch (hr) {case 0:
                if (lt[4] - lt[0] > gap && ct>4) {
                	fval[0] = 2;
                    //printf("case 0 and constant movement \n");
                } else if (lt[4] - lt[0] > gap) {
                	fval[0] = 2;
                    //printf("case 0 and sudent movement \n");
                } else {
                	fval[0] = 2;
                	//printf("Case 0 No mevement");
				} // lo anterior bien podría quitarse y únicamente dejar un valor, ya que todos
				//   los casos en los que el ritmo cardiaco es bajo, hay peligro
                break;
            case 1:
                if (lt[4] - lt[0] > gap && ct>4) {
                	fval[0] = 1;
                    //printf("case 1 and constant movement \n");
                } else if (lt[4] - lt[0] > gap) {
                	fval[0] = 2;
                    //printf("case 1 and sudent movement \n");
                } else {
                	fval[0] = 2;
                	//printf("Case 1 No mevement");
				}
                break;
            case 2:
                if (lt[4] - lt[0] > gap && ct>4) {
                	fval[0] = 2;
                    //printf("case 2 and constant movement: %d \n", fval[0]);
                } else if (lt[4] - lt[0] > gap) {
                	fval[0] = 0;
                    //printf("case 2 and sudent movement: %d \n", fval[0]);
                } else {
                	fval[0] = 0;
                	//printf("Case 2 No movement: %d \n", fval[0]);
				}
                break;
            default:
                printf("Error\n");
                break; // mejorar en futuras versiones, no hace falta este default
        }
		return fval[0];
        ct++;
        for (i = 0; i < 4; i++) {
            lt[i] = lt[i + 1];
        }
    }
}
```

## src/Hr_Strss_01.c
```c
#include <stdio.h>
#include <stdlib.h>
#include <unistd.h> 


int HR(int data[], int size) {
    int peaks[2] = {0};
    int hrl[7] = {0};
    int HRs[1] = {4};
    int ctr = 0;   // peaks counter
    int strt = 0;  
    int ctr2 = 0;  // last HR guaranteed

    while (1) {
        //sleep(1);
        
        //printf("%d\n", strt); // descomentar para pruebas
        //val = real data
        //hrl[ctr] = val; # for de moment:
        hrl[ctr] = data[strt];
        strt++;
        ctr++;
        while (strt > 5) {
            ctr++;
            //sleep(1);
            int i;
            //printf("%d\n", ctr);          

            if (hrl[3] > hrl[2] && hrl[3] > hrl[4] && hrl[3] > hrl[0] && hrl[3] > hrl[6]) {
                //printf("Ok\n");
                peaks[1] = ctr;
                int dpp = peaks[1] - peaks[0];
                switch (dpp) {
                    case 0 ... 17:
                        HRs[0] = 1;
                        break;
                    case 18 ... 23:
                        HRs[0] = 2;
                        break;
                    default:
                        HRs[0] = 0;
                        break;
                }
                ctr2++;
                peaks[0]=ctr;
            }

            for (i = 0; i < 6; i++) {
                hrl[i] = hrl[i + 1];
            }
            hrl[6] = data[strt];
            strt++;
            
            if (ctr2 > 1) {
                return HRs[0];
            }
        }
    }
}

int runStressDetectionAlgorithm(int gap, int hr) {
    int lt[5] = {0};
    int ct = 0;
    int i;
    int fval[1] = {0};

    while (1) {
        sleep(1);
        int lt0[6] = {0};

        for (i = 0; i < 6; i++) {
            lt0[i] = rand() % 11;
        }

        int val = lt0[0];
        for (i = 1; i < 6; i++) {
            if (lt0[i] > val) {
                val = lt0[i];
            }
        }

        lt[4] = val;

        switch (hr) {
            case 0:
                if (lt[4] - lt[0] > gap && ct>4) {
                	fval[0] = 2;
                    //printf("case 0 and constant movement \n");
                } else if (lt[4] - lt[0] > gap) {
                	fval[0] = 2;
                    //printf("case 0 and sudent movement \n");
                } else {
                	fval[0] = 2;
                	//printf("Case 0 No mevement");
				} // lo anterior bien podría quitarse y únicamente dejar un valor, ya que todos
				//   los casos en los que el ritmo cardiaco es bajo, hay peligro
                break;
            case 1:
                if (lt[4] - lt[0] > gap && ct>4) {
                	fval[0] = 1;
                    //printf("case 1 and constant movement \n");
                } else if (lt[4] - lt[0] > gap) {
                	fval[0] = 2;
                    //printf("case 1 and sudent movement \n");
                } else {
                	fval[0] = 2;
                	//printf("Case 1 No mevement");
				}
                break;
            case 2:
                if (lt[4] - lt[0] > gap && ct>4) {
                	fval[0] = 2;
                    //printf("case 2 and constant movement: %d \n", fval[0]);
                } else if (lt[4] - lt[0] > gap) {
                	fval[0] = 0;
                    //printf("case 2 and sudent movement: %d \n", fval[0]);
                } else {
                	fval[0] = 0;
                	//printf("Case 2 No movement: %d \n", fval[0]);
				}
                break;
            default:
                printf("Error\n");
                break; // mejorar en futuras versiones, no hace falta este default
        }
		return fval[0];
        ct++;
        for (i = 0; i < 4; i++) {
            lt[i] = lt[i + 1];
        }
    }
}
 
int main() {
    int sample1[] = {158233, 157389, 156587, 156082, 155676, 155377, 155204, 155121, 155027, 155010,
        155045, 155232, 155480, 155740, 155923, 156111, 156350, 156629, 156938, 157262,
        157655, 158051, 158540, 158915, 158754, 158233, 157839, 157704, 157601, 157495,
        157569, 157578, 157631, 157701, 157865, 158064, 158264, 158511, 158744, 159075,
        159303, 159508, 159941, 160288, 160321, 159943, 159355, 158965, 158773, 158718,
        158710, 158607, 158540, 158370, 158349, 158396, 158434, 158550, 158618, 158766,
        158880, 159042, 159242, 159354, 159392, 159003, 158569, 158328, 158184, 158119,
        158180, 158266, 158280, 158325, 158418, 158574, 158732, 158888, 159129, 159321,
        159515, 159757, 160081, 160378, 160561, 160643, 160308, 159857, 159557, 159434,
        159245, 159283, 159328, 159305, 159355, 159425, 159516, 159702, 159893, 160111,
        160327, 160526, 160802};

    int valhr = HR(sample1, sizeof(sample1) / sizeof(sample1[0]));
    //printf("%d\n", valhr);
    //runStressDetectionAlgorithm(5, valhr); // descomentar para pruebas
    int fv = runStressDetectionAlgorithm(5, valhr);
    printf("%d \n", fv);
    return 0;
}
```

## src/ICP20100.h
```c
#include <zephyr/kernel.h>
#include <zephyr/drivers/gpio.h>
#include <zephyr/drivers/i2c.h>
#include <zephyr/sys/printk.h>
#include <zephyr/device.h>
#include <zephyr/drivers/sensor.h>
#include <stdlib.h>

#define SLEEP_TIME_MS   1000

//0X63 = 0110 0011          0x31 = 0011 0001            0xC6 = 1100 0110
#define ICP20100_I2C_ADDRESS   0x63U // p. 20 

// Pressure
#define PRESS_ABS_LSB 0xC7U
#define PRESS_ABS_MSB 0xC8U
#define PRESS_DELTA_LSB 0xC9U
#define PRESS_DELTA_MSB 0xCAU

#define PRESS_DATA_0 0xFAU
#define PRESS_DATA_1 0xFBU
#define PRESS_DATA_2 0xFCU

// Temp
#define TEMP_DATA_0 0xFDU
#define TEMP_DATA_1 0xFEU
#define TEMP_DATA_2 0xFFU

#define I2C_NODE DT_NODELABEL(i2c0)
static const struct device *i2c_dev = DEVICE_DT_GET(I2C_NODE);


void readICP20100Data(int ICP20100values[2])
{
    if (!i2c_dev) {
        printk("Error al obtener el controlador I2C\n");
        return;
    }

    uint8_t data[2]; // Buffer sensor data
    uint32_t pressure, temperature;

    // Configure data transfer (press)
    uint8_t pressure_register[2] = {PRESS_DATA_0, PRESS_DATA_1};
    int ret = i2c_write(i2c_dev, pressure_register, sizeof(pressure_register), ICP20100_I2C_ADDRESS);
    if (ret < 0) {
        printk("Error al escribir la dirección de presión: %d\n", ret);
        return;
    }

    ret = i2c_read(i2c_dev, data, sizeof(data), ICP20100_I2C_ADDRESS);
    if (ret < 0) {
        printk("Error al leer datos de presión: %d\n", ret);
        return;
    }

    // Convertir datos de presión
    pressure = (data[1] << 8) | data[0];

    // Configure data transfer (temp)
    uint8_t temp_register[2] = {TEMP_DATA_0, TEMP_DATA_1};
    ret = i2c_write(i2c_dev, temp_register, sizeof(temp_register), ICP20100_I2C_ADDRESS);
    if (ret < 0) {
        printk("Error al escribir la dirección de temperatura: %d\n", ret);
        return;
    }

    ret = i2c_read(i2c_dev, data, sizeof(data), ICP20100_I2C_ADDRESS);
    if (ret < 0) {
        printk("Error al leer datos de temperatura: %d\n", ret);
        return;
    }

    // Convertir datos de temperatura
    temperature = (data[1] << 8) | data[0];

    // Ahora los datos están en las variables "pressure" y "temperature"
    //printk("Presión: %u\n", pressure);
    //printk("Temperatura: %u\n", temperature);
    
    ICP20100values[0] = pressure;
    ICP20100values[1] = temperature;

}
```

## src/LED_RGB.h
```c
#include <zephyr/kernel.h>
#include <zephyr/drivers/gpio.h>
#include <zephyr/drivers/pwm.h>
#include <zephyr/device.h>
#include <hal/nrf_gpio.h>

// With LED tire
#define RGB_LED_NODE DT_ALIAS(gpio0)

#define R_PIN DT_GPIO_PIN(RGB_LED_NODE, r_gpios)
#define G_PIN DT_GPIO_PIN(RGB_LED_NODE, g_gpios)
#define B_PIN DT_GPIO_PIN(RGB_LED_NODE, b_gpios)

#define SLEEP_TIME_MS   1000

#define RED    1, 0, 0
#define GREEN  0, 1, 0
#define BLUE   0, 0, 1

void set_rgb_color(const struct device *dev, gpio_pin_t pin_r, gpio_pin_t pin_g, gpio_pin_t pin_b, uint8_t r, uint8_t g, uint8_t b)
{
    gpio_pin_set(dev, pin_r, r);
    gpio_pin_set(dev, pin_g, g);
    gpio_pin_set(dev, pin_b, b);
}

void LED3(int val)
{
    const struct device *rgb_led = device_get_binding(DT_LABEL(RGB_LED_NODE));
    if (!rgb_led)
    {
        printk("RGB LED device not ready\n");
        return;
    }

    int err = gpio_pin_configure(rgb_led, R_PIN, GPIO_OUTPUT);
    if (err)
    {
        printk("Error configuring red pin: %d\n", err);
        return;
    }

    err = gpio_pin_configure(rgb_led, G_PIN, GPIO_OUTPUT);
    if (err)
    {
        printk("Error configuring green pin: %d\n", err);
        return;
    }

    err = gpio_pin_configure(rgb_led, B_PIN, GPIO_OUTPUT);
    if (err)
    {
        printk("Error configuring blue pin: %d\n", err);
        return;
    }

    while (1)
    {
        switch (val)
    {
    case 1:
        // blue
        set_rgb_color(rgb_led, R_PIN, G_PIN, B_PIN, BLUE);
        k_sleep(K_MSEC(SLEEP_TIME_MS));
        break;
    case 2:
        // red
        set_rgb_color(rgb_led, R_PIN, G_PIN, B_PIN, RED);
        k_sleep(K_MSEC(SLEEP_TIME_MS));
        break;
    case 0:
        // green
        set_rgb_color(rgb_led, R_PIN, G_PIN, B_PIN, GREEN);
        k_sleep(K_MSEC(SLEEP_TIME_MS));
        break;
    default:
        break;
    }
        
    }
}

// In case having 3 different LEDs (easiest scenario)
/*
#define LED_GREEN_NODE DT_ALIAS(led0)  // Just change pins
#define LED_YELLOW_NODE DT_ALIAS(led1)
#define LED_RED_NODE DT_ALIAS(led2)

#define SLEEP_TIME_MS   1000

void turn_on_led(const struct device *dev, gpio_pin_t pin)
{
    gpio_pin_set(dev, pin, 1);
}

void turn_off_led(const struct device *dev, gpio_pin_t pin)
{
    gpio_pin_set(dev, pin, 0);
}

//void main(void)   // LEDS3
void LED3()
{
    const struct device *led_green_dev = device_get_binding(DT_LABEL(LED_GREEN_NODE));
    const struct device *led_yellow_dev = device_get_binding(DT_LABEL(LED_YELLOW_NODE));
    const struct device *led_red_dev = device_get_binding(DT_LABEL(LED_RED_NODE));

    if (!led_green_dev || !led_yellow_dev || !led_red_dev)
    {
        printk("Error obtaining LED devices\n");
        return;
    }

    gpio_pin_configure(led_green_dev, DT_GPIO_PIN(LED_GREEN_NODE, gpios), GPIO_OUTPUT);
    gpio_pin_configure(led_yellow_dev, DT_GPIO_PIN(LED_YELLOW_NODE, gpios), GPIO_OUTPUT);
    gpio_pin_configure(led_red_dev, DT_GPIO_PIN(LED_RED_NODE, gpios), GPIO_OUTPUT);

    while (1)
    {
        turn_on_led(led_green_dev, DT_GPIO_PIN(LED_GREEN_NODE, gpios));
        k_sleep(K_MSEC(SLEEP_TIME_MS));

        turn_off_led(led_green_dev, DT_GPIO_PIN(LED_GREEN_NODE, gpios));
        turn_on_led(led_yellow_dev, DT_GPIO_PIN(LED_YELLOW_NODE, gpios));
        k_sleep(K_MSEC(SLEEP_TIME_MS));

        turn_off_led(led_yellow_dev, DT_GPIO_PIN(LED_YELLOW_NODE, gpios));
        turn_on_led(led_red_dev, DT_GPIO_PIN(LED_RED_NODE, gpios));
        k_sleep(K_MSEC(SLEEP_TIME_MS));

        turn_off_led(led_red_dev, DT_GPIO_PIN(LED_RED_NODE, gpios));
    }
}
*/
```

## src/LSM6DSV16X.h
```c
//#include <zephyr/drivers/gpio.h>
#include <zephyr/drivers/i2c.h>
#include <zephyr/sys/printk.h>
#include <zephyr/kernel.h>
#include <zephyr/device.h>
#include <zephyr/drivers/sensor.h>
#include <stdlib.h> 
#include <stdio.h>  


#define I2C_NODE DT_NODELABEL(i2c0)
static const struct device *i2c_dev = DEVICE_DT_GET(I2C_NODE);
//static const struct i2c_dt_spec dev_i2c = I2C_DT_SPEC_GET(I2C_NODE);

/* 1000 msec = 1 sec */
#define SLEEP_TIME_MS   1000

/** I2C Device Address 8 bit format  if SA0=0 -> D5 if SA0=1 -> D7 **/
#define LSM6DSV16X_I2C_ADD_L                    0xD5U
#define LSM6DSV16X_I2C_ADD_H                    0xD7U
/** Device Identification (Who am I) **/
#define LSM6DSV16X_ID                           0x70U

#define LSM6DSV16X_WHO_AM_I                    0x0FU
#define LSM6DSV16X_I2C_ADDRESS   0x0F // p. 22 Datasheet, viene de D5>1

#define LSM6DSV16X_OUTX_L_G                    0x22U // p. 53
#define LSM6DSV16X_OUTX_H_G                    0x23U
#define LSM6DSV16X_OUTY_L_G                    0x24U
#define LSM6DSV16X_OUTY_H_G                    0x25U
#define LSM6DSV16X_OUTZ_L_G                    0x26U
#define LSM6DSV16X_OUTZ_H_G                    0x27U

#define LSM6DSV16X_OUTX_L_A                    0x28U
#define LSM6DSV16X_OUTX_H_A                    0x29U
#define LSM6DSV16X_OUTY_L_A                    0x2AU
#define LSM6DSV16X_OUTY_H_A                    0x2BU
#define LSM6DSV16X_OUTZ_L_A                    0x2CU
#define LSM6DSV16X_OUTZ_H_A                    0x2DU

#define SENSOR_CHAN_ACCEL_XYZ 0x10 
#define SENSOR_CHAN_GYRO_XYZ 0x11  

#define LSM6DSV16X_I2C_ADDR 0x70
#define LSM6DSV16X_REG_DATA 0x0F


void readLSM6DSV16XData(int LSM6DSV16Xvalues[6])
{
    //const struct device *i2c_dev;
    uint8_t accel_x_lsb, accel_x_msb, accel_y_lsb, accel_y_msb, accel_z_lsb, accel_z_msb;
    uint8_t gyro_x_lsb, gyro_x_msb, gyro_y_lsb, gyro_y_msb, gyro_z_lsb, gyro_z_msb;

    if (!i2c_dev) {
        printk("I2C: Device not found.\n");
        return;
    }

    // Leer los registros del acelerómetro en el eje X
    if (i2c_read(i2c_dev, &accel_x_lsb, 1, LSM6DSV16X_OUTX_L_A) < 0 ||
        i2c_read(i2c_dev, &accel_x_msb, 1, LSM6DSV16X_OUTX_H_A) < 0) {
        printk("Error reading accelerometer X data\n");
        return;
    }

    // Leer los registros del acelerómetro en el eje Y
    if (i2c_read(i2c_dev, &accel_y_lsb, 1, LSM6DSV16X_OUTY_L_A) < 0 ||
        i2c_read(i2c_dev, &accel_y_msb, 1, LSM6DSV16X_OUTY_H_A) < 0) {
        printk("Error reading accelerometer Y data\n");
        return;
    }

    // Leer los registros del acelerómetro en el eje Z
    if (i2c_read(i2c_dev, &accel_z_lsb, 1, LSM6DSV16X_OUTZ_L_A) < 0 ||
        i2c_read(i2c_dev, &accel_z_msb, 1, LSM6DSV16X_OUTZ_H_A) < 0) {
        printk("Error reading accelerometer Z data\n");
        return;
    }

    // Leer los registros del giroscopio en el eje X
    if (i2c_read(i2c_dev, &gyro_x_lsb, 1, LSM6DSV16X_OUTX_L_G) < 0 ||
        i2c_read(i2c_dev, &gyro_x_msb, 1, LSM6DSV16X_OUTX_H_G) < 0) {
        printk("Error reading gyroscope X data\n");
        return;
    }

    // Leer los registros del giroscopio en el eje Y
    if (i2c_read(i2c_dev, &gyro_y_lsb, 1, LSM6DSV16X_OUTY_L_G) < 0 ||
        i2c_read(i2c_dev, &gyro_y_msb, 1, LSM6DSV16X_OUTY_H_G) < 0) {
        printk("Error reading gyroscope Y data\n");
        return;
    }

    // Leer los registros del giroscopio en el eje Z
    if (i2c_read(i2c_dev, &gyro_z_lsb, 1, LSM6DSV16X_OUTZ_L_G) < 0 ||
        i2c_read(i2c_dev, &gyro_z_msb, 1, LSM6DSV16X_OUTZ_H_G) < 0) {
        printk("Error reading gyroscope Z data\n");
        return;
    }

    // Combina LSB y MSB para obtener los valores finales
    int16_t accel_x = (accel_x_msb << 8) | accel_x_lsb;
    int16_t accel_y = (accel_y_msb << 8) | accel_y_lsb;
    int16_t accel_z = (accel_z_msb << 8) | accel_z_lsb;

    int16_t gyro_x = (gyro_x_msb << 8) | gyro_x_lsb;
    int16_t gyro_y = (gyro_y_msb << 8) | gyro_y_lsb;
    int16_t gyro_z = (gyro_z_msb << 8) | gyro_z_lsb;

    // Imprime los valores del acelerómetro y el giroscopio
    /*
    printk("Accel X: %d\n", accel_x);
    printk("Accel Y: %d\n", accel_y);
    printk("Accel Z: %d\n", accel_z);
    printk("Gyro X: %d\n", gyro_x);
    printk("Gyro Y: %d\n", gyro_y);
    printk("Gyro Z: %d\n", gyro_z);
    */
    
    LSM6DSV16Xvalues[0] = accel_x;
    LSM6DSV16Xvalues[1] = accel_y;
    LSM6DSV16Xvalues[2] = accel_z;
    LSM6DSV16Xvalues[3] = gyro_x;
    LSM6DSV16Xvalues[4] = gyro_y;
    LSM6DSV16Xvalues[5] = gyro_z;
}
```

## src/MAX30001.h
```c
// Code for the reading of MAX30001 (ECG & BioZ) by SPI interface 

#include <zephyr/kernel.h>
#include <zephyr/device.h>
#include <zephyr/drivers/spi.h>
#include <stdlib.h>
#include <zephyr/logging/log.h>

// ADDRESSES
#define MAX30001_REG_INFO       0x0FU
#define MAX30001_REG_CNFG_GEN   0x10U
#define MAX30001_REG_CNFG_ECG   0x15U
#define MAX30001_REG_CNFG_BIOZ  0x18U
#define MAX30001_REG_CNFG_RTOR1 0x1DU

// 1rst way
LOG_MODULE_REGISTER(main, LOG_LEVEL_DBG);

#define SPI_DEV_NAME      "SPI_1"
#define MAX30001_SPI_FREQ 5000000  //  check datasheet

static struct spi_config spi_cfg = {
    .frequency = MAX30001_SPI_FREQ,
    .operation = (SPI_OP_MODE_MASTER | SPI_WORD_SET(8) | SPI_LINES_SINGLE),
    .slave = 0,
};

static const struct device *spi_dev;

void max30001_configure(void)
{
    int ret;

    uint8_t cnfg_ecg_value = MAX30001_REG_CNFG_ECG; // Configure if needed
    uint8_t cnfg_bioz_value = MAX30001_REG_CNFG_BIOZ; 
    uint8_t cnfg_rtor1_value = MAX30001_REG_CNFG_RTOR1; 

    struct spi_buf tx_buf[] = {
        {
            .buf = &cnfg_ecg_value,
            .len = sizeof(cnfg_bioz_value),
        },
        {
            .buf = &cnfg_ecg_value,
            .len = sizeof(cnfg_ecg_value),
        },
        {
            .buf = &cnfg_bioz_value,
            .len = sizeof(cnfg_bioz_value),
        },
        {
            .buf = &cnfg_bioz_value,
            .len = sizeof(cnfg_bioz_value),
        },
        {
            .buf = &cnfg_rtor1_value,
            .len = sizeof(cnfg_rtor1_value),
        },
        {
            .buf = &cnfg_rtor1_value,
            .len = sizeof(cnfg_rtor1_value),
        },
    };

    struct spi_buf_set tx_set = {
        .buffers = tx_buf,
        .count = ARRAY_SIZE(tx_buf),
    };

    ret = spi_write(spi_dev, &spi_cfg, &tx_set);
    if (ret) {
        LOG_ERR("Error al configurar MAX30001: %d", ret);
    }
}

void max30001_read_data(uint8_t reg_address, uint8_t *rx_data, uint16_t num_samples)
{
    int ret;

    struct spi_buf tx_buf = {
        .buf = &reg_address,
        .len = sizeof(reg_address),
    };

    struct spi_buf rx_buf = {
        .buf = rx_data,
        .len = num_samples,
    };

    ret = spi_transceive(spi_dev, &spi_cfg, &tx_buf, &rx_buf);
    if (ret) {
        LOG_ERR("Error reading MAX30001: %d", ret);
    }
}

void readMAX30001Data(int MAX30001values[3])
{
    

    spi_dev = device_get_binding(SPI_DEV_NAME);
    if (!spi_dev) {
        LOG_ERR("No se pudo obtener el dispositivo SPI");
        return 0;
    }

    max30001_configure();

    // Variables for achieve ECG, BIOZ and RTOR1 data
    uint8_t ecg_data[100];  // Adjust
    uint8_t bioz_data[100]; 
    uint8_t rtor1_data[100];

    
    max30001_read_data(MAX30001_REG_CNFG_ECG, ecg_data, sizeof(ecg_data));
    max30001_read_data(MAX30001_REG_CNFG_BIOZ, bioz_data, sizeof(bioz_data));
    max30001_read_data(MAX30001_REG_CNFG_RTOR1, rtor1_data, sizeof(rtor1_data));

    LOG_HEXDUMP_INF(ecg_data, sizeof(ecg_data), "Datos ECG: ");
    LOG_HEXDUMP_INF(bioz_data, sizeof(bioz_data), "Datos BIOZ: ");
    LOG_HEXDUMP_INF(rtor1_data, sizeof(rtor1_data), "Datos RTOR1: ");

    
    
    MAX30001values[0] = ecg_data;
    MAX30001values[1] = bioz_data;
    MAX30001values[2] = rtor1_data;
    
}
```

## src/MAX30210.h
```c
#include <zephyr/kernel.h>
#include <zephyr/device.h>
#include <zephyr/drivers/sensor.h>
#include <stdlib.h>
#include <zephyr/drivers/i2c.h>
#include <zephyr/sys/printk.h>

#define MAX30210_I2C_ADDRESS   0x80U
#define TEMP_DATA_MSB          0x2BU 
#define TEMP_DATA_LSB          0x2CU 


#define I2C_NODE DT_NODELABEL(i2c0)
static const struct device *i2c_dev = DEVICE_DT_GET(I2C_NODE);


void readMAX30210Data(int MAX30210values[1])
{
    if (!i2c_dev) {
        printk("I2C Error \n");
        return;
    }

    uint8_t data[2]; 
    uint32_t temperature;

    uint8_t temp_register[2] = {TEMP_DATA_LSB, TEMP_DATA_MSB};
    int ret = i2c_write(i2c_dev, temp_register, sizeof(temp_register), MAX30210_I2C_ADDRESS);
    if (ret < 0) {
        printk("Writting Error: %d\n", ret);
        return;
    }

    ret = i2c_read(i2c_dev, data, sizeof(data), MAX30210_I2C_ADDRESS);
    if (ret < 0) {
        printk("Reading Error: %d\n", ret);
        return;
    }

    //temperature = (data[1] << 8) | data[0];
    MAX30210values[0] = (data[1] << 8) | data[0];

    printk("Temperatura corporal: %u\n", temperature);
    //printk("MAX30210: %.2f °C \n", temperature);
    

}
```

## src/MAX86140.h
```c
// Code for the reading of MAX86140 (Sp02) by SPI interface
//  
//#include <zephyr/zephyr.h>
#include <zephyr/device.h>
#include <zephyr/drivers/spi.h>
#include <zephyr/logging/log.h>
#include <zephyr/kernel.h>
#include <zephyr/drivers/gpio.h>
#include <zephyr/drivers/spi.h>
// 
#define MAX86140_CHIPID_REG     0xFF   
#define ADD_REG_WHO_AM_I        0xFF
#define UC_WHO_AM_I_DEFAULT_VALUE 0xFF // check difference

#define LED1_SEQ_REG 			0x20 // use sequence
#define LED2_SEQ_REG 			0x21
#define LED3_SEQ_REG 			0x22

#define UC_ADD_REG_CTRL_4_CFG_VALUE 0xF9 // check
#define ADD_REG_CTRL_4          0x12    // check

#define LED1_REG				0x23
#define LED2_REG				0x24
#define LED3_REG				0x25

#define PPG_SYNC_CTRL_REG		0x10
#define PPG_CONFIG              0x11
#define MEMORY_CRTL				0xF2
#define MEMORY_INDEX			0xF3
#define MEMORY_DATA				0xF4

#define FIFO_WRITE_PTR          0x04
#define FIFO_READ_PNTR          0x05
#define FIFO_DATA_REG           0x08
#define FIFO_CONFIG             0x09
#define MEMORY                  0xF2

#define SPI_BUFSIZE  8   //SPI Communication buffer size
#define SPI_INSTANCE  0 //SPI Instance to be used

uint8_t   spi_tx_buf[SPI_BUFSIZE]; // spi tx buffer 
uint8_t   spi_rx_buf[SPI_BUFSIZE]; // spi rx buffer

//spi_buf and spi_buf_set structures to hold the buffer values for SPI
struct spi_buf tx_buf_arr; 
struct spi_buf_set tx;
struct spi_buf rx_buf_arr;
struct spi_buf_set rx ;

volatile  uint8_t   SPIReadLength, SPIWriteLength; // variables to hold read and write lengths


#define SPI_NODE DT_NODELABEL(spi1)
static const struct device *spi_dev = DEVICE_DT_GET(SPI_NODE);
//const struct device *spi_dev = DEVICE_DT_GET(SPI_NODE) ;
struct spi_config spi_cfg ;
struct spi_cs_control chip;


#define MY_GPIO1 DT_NODELABEL(gpio1)
#define GPIO_1_CS    3  // Chip select
const struct device *gpio1_dev = DEVICE_DT_GET(MY_GPIO1);


/* set read single command. Attention: command must be 0x3F at most */
#define SET_READ_SINGLE_CMD(x)			(x | 0x80)
/* set read multiple command. Attention: command must be 0x3F at most */
#define SET_READ_MULTI_CMD(x)			(x | 0xC0)
/* set write single command. Attention: command must be 0x3F at most */
#define SET_WRITE_SINGLE_CMD(x)			(x & (~(0xC0)))
/* set write multiple command. Attention: command must be 0x3F at most */
#define SET_WRITE_MULTI_CMD(x)			(x & (~(0x80))	\
                                                 x |= 0x40)

/* A function to write into sensor Internal Register */
static void MAX86140_write_reg(int reg, int data)
{
    SPIWriteLength = 2; // set the spi write length to 2 bytes
    SPIReadLength = 0; // set the read length
    
    spi_tx_buf[0] = SET_WRITE_SINGLE_CMD(reg); // set the first byte which is a write command
    spi_tx_buf[1] = data; // A byte of data to be sent

   //specifying the tx and rx buffer specific to zephyr's SPI drivers
   	tx_buf_arr.buf = spi_tx_buf;
    tx_buf_arr.len = SPIWriteLength;
    tx.buffers = &tx_buf_arr;
    tx.count = 1;
	
    rx_buf_arr.buf = spi_rx_buf;
    rx_buf_arr.len = SPIReadLength;

    rx.buffers = &rx_buf_arr ;
    rx.count = 1;

	int error = spi_transceive(spi_dev, &spi_cfg, &tx,&rx);
	if(error != 0){
		printk("SPI transceive error: %i\n", error);
	}   
}

/* A function to read a value from the internal register of max86140 */
int MAX86140_read_reg(int reg)
{	
    /* Set the read command for reading a single byte */
    spi_tx_buf[0] = SET_READ_SINGLE_CMD(reg);
  
   //specifying the tx and rx buffer specific to zephyr's SPI drivers
   	tx_buf_arr.buf = spi_tx_buf;
    tx_buf_arr.len = 2;

    tx.buffers = &tx_buf_arr;
    tx.count = 1;
	
    rx_buf_arr.buf = spi_rx_buf;
    rx_buf_arr.len = 2;

    rx.buffers = &rx_buf_arr ;
    rx.count = 1;

	int error = spi_transceive(spi_dev,&spi_cfg,&tx,&rx);
	if(error != 0){
		printk("SPI transceive error: %i\n", error);
		return error;
	}

    return spi_rx_buf[1];
}

void printbuffers()
{
    printk("SPI TX: ");
	for (int j = 0; j<sizeof(spi_tx_buf); j++)
	{
		printk(" %x",spi_tx_buf[j]);
	}
	printk("\r\nSPI RX: ");
	for (int j = 0; j<sizeof(spi_rx_buf); j++)
	{
		printk(" %x",spi_rx_buf[j]);
	}
    printk("\r\n");
}

// Configuration of the SPI
void SPI_Init(void)
{
 	if (!device_is_ready(spi_dev)) {
        /* Device is not ready to use */
		printk("\r\nStop device not ready\r\n");
	}
    
	    if (chip.gpio.pin == NULL)
		    printk("CS CHIP PIN NOT READY\r\n");

    MAX86140_init();
}

struct spi_config spi_cfg = {
        .frequency = 125000U, //4000000, // p. 8
        .operation = SPI_WORD_SET(8), // 1 byte, 8 bits
        .slave = 0, // specify slave
};

// Initialize sensor
void MAX86140_init(void)
{   
    int regval;

    /* Read the who am i register to confirm sensor is communicating with our nrf device */
    regval = MAX86140_read_reg(ADD_REG_WHO_AM_I);

    /* check the who am i register value and compare it with default who am i value for max86140 
        if who am i is correct then proced */
    if( regval == UC_WHO_AM_I_DEFAULT_VALUE )
    {
        MAX86140_write_reg(ADD_REG_CTRL_4, UC_ADD_REG_CTRL_4_CFG_VALUE); // Specify

            /* verify written value */
        regval = MAX86140_read_reg(ADD_REG_CTRL_4);

            /* if written value is different */
        if( regval != UC_ADD_REG_CTRL_4_CFG_VALUE )
        {
                /* ERROR: stay here... */
            while(1)
            {
                printk("\r\nWrite Reg ERR\r\n");
                k_msleep(500);
            }
        }
    }
    else
    {
      /* ERROR: stay here... */
      while(1)
        {
            printk("\nDevice does not exist\r\n");
            k_msleep(10000);
        }			   
    }
}

void get_LEDS( int* x, int* y)
{

    *x = (MAX86140_read_reg(LED1_REG) << 8);
    *y = (MAX86140_read_reg(LED2_REG) << 8);
}

void readMAX86140Data(int MAX86140values[2])
{
	
    //Call the SPI initialization function
    SPI_Init();
    
	int led1, led2;
	//values that hold the values of acceleration in mg
    while(true)
      {
		get_LEDS(&led1,&led2);		
		printk("hr= %6d spo2= %6d \r\n", led1, led2);
		k_msleep(400);
      }
      
      MAX86140values[0] = led1;
      MAX86140values[1] = led2;

}
```

## src/Motor.h
```c
// Configuración del PWM 

#include <zephyr/kernel.h>
#include <zephyr/drivers/pwm.h>
#include <zephyr/device.h>

// Velocidades del motor
#define SPEED_STOP  0
#define SPEED_LOW   1000
#define SPEED_HIGH  2000

// Duraciones de operación del motor en milisegundos
#define DURATION_STOP    0
#define DURATION_SHORT   1000
#define DURATION_LONG    2000

// Constantes de ejemplo, ajusta según tus necesidades
#define PWM_PERIOD_US 20000
#define PWM_CHANNEL 0

// Declaración de la estructura pwm_config
struct pwm_config {
    uint32_t frequency;
    uint32_t period;
    uint32_t pulse_width;
    uint8_t flags;
};

// Variable global para almacenar la velocidad actual
uint32_t current_speed = SPEED_STOP;
uint32_t current_duration = DURATION_STOP;

// Declaración de la función para evitar el error
void pwm_change_fn(struct k_timer *dummy);

// Timers
K_TIMER_DEFINE(pwm_change_timer, pwm_change_fn, NULL);

// Función para cambiar la velocidad y duración del motor
void change_motor_speed_and_duration(int val)
{
    switch (val)
    {
    case 1:
        //current_speed = SPEED_LOW;
        current_duration = DURATION_SHORT;
        break;
    case 2:
        //current_speed = SPEED_HIGH;
        current_duration = DURATION_LONG;
        break;
    case 0:
        //current_speed = SPEED_STOP;
        current_duration = DURATION_STOP;
        break;
    default:
        //current_speed = SPEED_STOP;
        current_duration = DURATION_STOP;
        break;
    }
}

// Función para cambiar el valor del PWM
void pwm_change_fn(struct k_timer *dummy)
{
    int val = 0;
    int err = pwm_pin_set_usec(pwm_dev, PWM_CHANNEL, PWM_PERIOD_US, current_speed, PWM_FLAGS);
    if (err < 0) {
        printk("Error al cambiar el valor del PWM. Código de error: %i\n", err);
    }

    // Cambiar la velocidad y duración del motor en cada intervalo de temporizador
    change_motor_speed_and_duration(val);
}

// Función para configurar y aplicar la configuración inicial del PWM
void setup_pwm(const struct device *pwm_dev)
{
    struct pwm_config pwm_cfg = {
        .frequency = 1000,
        .period = PWM_PERIOD_US,
        .pulse_width = 0,
        .flags = 0,
    };

    int ret = pwm_pin_set_config(pwm_dev, PWM_CHANNEL, &pwm_cfg);
    if (ret < 0) {
        printk("Error al configurar el PWM. Código de error: %i\n", ret);
        return;
    }
}

void Motor(int val)
{
    const struct device *pwm_dev;

    change_motor_speed_and_duration(val)

    pwm_dev = device_get_binding(PWM_CTRL);
    if (!pwm_dev) {
        printk("Error al obtener el controlador PWM\n");
        return;
    }

    // Configurar y aplicar la configuración inicial del PWM
    setup_pwm(pwm_dev);

    // Iniciar el temporizador de cambio de PWM
    k_timer_start(&pwm_change_timer, K_MSEC(200), K_MSEC(200));

    while (1) {
        k_sleep(K_MSEC(current_duration));
    }
}
```
